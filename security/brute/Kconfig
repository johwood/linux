## security/brute/Kconfig
```kconfig
# SPDX-License-Identifier: GPL-2.0
config SECURITY_FORK_BRUTE
	bool "Fork brute force attack detection and mitigation"
	depends on SECURITY
	help
	  This is an LSM that stops any fork brute force attack against
	  vulnerable userspace processes. The detection method is based on
	  the application crash period and as a mitigation procedure all the
	  offending tasks are killed. Like capabilities, this security module
	  stacks with other LSMs. Further information can be found in
	  Documentation/admin-guide/LSM/Brute.rst.

	  If you are unsure how to answer this question, answer N.
```

## security/fbfam/Kconfig
```kconfig
# SPDX-License-Identifier: GPL-2.0
config FBFAM
	bool "Fork brute force attack mitigation"
	default n
	help
	  This is a user defense that detects any fork brute force attack
	  based on the application's crashing rate. When this measure is
	  triggered the fork system call is blocked.

	  If you are unsure how to answer this question, answer N.
```
